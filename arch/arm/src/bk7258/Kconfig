## boards/arm/mcx-nxxx/frdm-mcxn947/configs/xts_core/defconfig
```kconfig
#
# openvela xTS core test image for FRDM-MCXN947.
#
# This configuration enables the core no-extra-hardware xTS applications.
#

CONFIG_ARCH="arm"
CONFIG_ARCH_BOARD="frdm-mcxn947"
CONFIG_ARCH_BOARD_FRDM_MCXN947=y
CONFIG_ARCH_CHIP="mcx-nxxx"
CONFIG_ARCH_CHIP_MCX_NXXX=y
CONFIG_ARCH_CHIP_N947=y
# CONFIG_ARCH_LEDS is not set
CONFIG_ARCH_INTERRUPTSTACK=4096
CONFIG_ARCH_STACKDUMP=y
CONFIG_BOARD_LATE_INITIALIZE=y
CONFIG_BOARD_LOOPSPERMSEC=2664
CONFIG_BUILTIN=y
CONFIG_DEBUG_FEATURES=y
CONFIG_DEBUG_SYMBOLS=y
CONFIG_DEFAULT_TASK_STACKSIZE=8192
CONFIG_FS_PROCFS=y
CONFIG_FS_TMPFS=y
CONFIG_IDLETHREAD_STACKSIZE=4096
CONFIG_INIT_ENTRYPOINT="nsh_main"
CONFIG_INPUT=y
CONFIG_INTELHEX_BINARY=y
CONFIG_LIBC_FLOATINGPOINT=y
CONFIG_LIBC_LOCALTIME=y
CONFIG_LIBC_LONG_LONG=y
CONFIG_LIBC_SCANSET=y
CONFIG_LPUART4_SERIAL_CONSOLE=y
CONFIG_MM_REGIONS=2
CONFIG_NSH_BUILTIN_APPS=y
CONFIG_NSH_FILEIOSIZE=512
CONFIG_NXXX_LPUART4=y
CONFIG_PIPES=y
CONFIG_RAM_SIZE=425984
CONFIG_RAM_START=0x20000000
CONFIG_RAW_BINARY=y
CONFIG_SCHED_BACKTRACE=y
CONFIG_SCHED_HPWORK=y
CONFIG_SCHED_LPWORK=y
CONFIG_SERIAL_TERMIOS=y
CONFIG_STACK_COLORATION=y
CONFIG_START_DAY=14
CONFIG_START_MONTH=3
CONFIG_SYSLOG_CONSOLE=y
CONFIG_SYSTEM_NSH=y
CONFIG_SYSTEM_POPEN=y
CONFIG_SYSTEM_SYSTEM=y

# xTS 1.1 simple kernel/libc applications

CONFIG_EXAMPLES_HELLO=y
CONFIG_EXAMPLES_PIPE=y
CONFIG_EXAMPLES_POPEN=y
CONFIG_TESTING_GETPRIME=y
CONFIG_TESTING_MM=y
CONFIG_TESTING_OSTEST=y
CONFIG_TESTING_SCANFTEST=y

# xTS 1.3 RAM and filesystem applications

CONFIG_TESTING_FSTEST=y
CONFIG_TESTING_FSTEST_NLOOPS=10
CONFIG_TESTING_RAMTEST=y
```

## boards/arm/stm32h7/stm32h750b-dk/Kconfig
```kconfig
#
# For a description of the syntax of this configuration file,
# see the file kconfig-language.txt in the NuttX tools repository.
#

if ARCH_BOARD_STM32H750B_DK

config STM32H750B_DK_BUTTONS
	bool "Board button support (USER1 on PC13)"
	default n
	select ARCH_HAVE_BUTTONS
	select ARCH_HAVE_IRQBUTTONS
	---help---
		Support the B1 USER pushbutton on PC13.  Builds the board button
		interface (board_button_initialize, board_buttons and
		board_button_irq), and permits ARCH_BUTTONS, ARCH_IRQBUTTONS,
		INPUT_BUTTONS and INPUT_BUTTONS_LOWER, which together register
		the button driver as /dev/buttons.

		The pin is an input with a pull-down and reads high while the
		button is depressed (ST BSP v3.3.4 and on-board measurement).

config STM32H750B_DK_QSPI_BOOT
	bool "Link Cortex-M7 image for external QSPI boot"
	default n
	depends on ARCH_CHIP_STM32H7_CORTEXM7
	---help---
		Build the main NuttX image for the STM32H750B-DK external
		dual-QSPI memory-mapped window at 0x90000000 instead of the
		128 KiB on-die Flash at 0x08000000. This image needs a small
		internal-Flash boot stub that initializes QSPI memory-mapped
		mode before jumping to the external vector table.

endif # ARCH_BOARD_STM32H750B_DK
```

## boards/arm/t113/t113-evb/Kconfig
```kconfig
if ARCH_BOARD_T113_EVB

source "boards/arm/t113/t113-evb/uartring/Kconfig"

config T113_LRADC_KEYPAD
	bool "LRADC resistor-ladder keypad (5 keys)"
	default n
	depends on T113_LRADC
	select INPUT
	select INPUT_KEYBOARD
	---help---
		Register /dev/kbd0 fed by the on-board LRADC 5-button
		resistor ladder (VOL+/VOL-/MENU/ENTER/HOME).  Maps raw
		6-bit LRADC samples to standard Linux keycodes via the
		NuttX keyboard upper-half.

config T113_CTP
	bool "Capacitive Touch Panel on J27 (TWI2 PD20/PD21)"
	default n
	depends on T113_TWI2 && T113_GPIO_IRQ
	---help---
		Enable the board glue for the MIPI FFC capacitive touch panel.
		Drives CTP-RST (PD18) and CTP-INT (PD19), brings up TWI2, and
		registers either the Goodix GT9xx or FocalTech FT5x06 upper
		driver as /dev/input0.

if T113_CTP

choice
	prompt "CTP IC family"
	default T113_CTP_TLSC6X

config T113_CTP_GT9XX
	bool "Goodix GT911 / GT9xx (I2C 0x5D)"
	select INPUT_GT9XX
	---help---
		Enable the Goodix GT9xx upper driver; uses the GT911 address
		latch trick (INT=LOW at reset release -> 0x5D).

config T113_CTP_FT5X06
	bool "FocalTech FT5x06 / FT6236 (I2C 0x38)"
	select INPUT_FT5X06
	---help---
		Enable the FocalTech FT5x06 upper driver.  No address trick.

config T113_CTP_TLSC6X
	bool "TLSC6X (I2C 0x2E)"
	select INPUT_TLSC6X
	---help---
		Enable the TLSC6X upper driver for the capacitive touch panel
		on J27.

endchoice

endif # T113_CTP

endif
```
