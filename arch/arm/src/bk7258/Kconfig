## arch/risc-v/src/esp32p4/Kconfig
```kconfig
#
# For a description of the syntax of this configuration file,
# see the file kconfig-language.txt in the NuttX tools repository.
#

if ARCH_CHIP_ESP32P4

source "arch/risc-v/src/common/espressif/Kconfig"

config ESP32P4_SELECTS_REV_LESS_V3
	bool "Select ESP32-P4 revisions <3.0 (No >=3.x Support)"
	default n
	---help---
		Select this option to support ESP32-P4 revisions 0.x and 1.x.
		Revisions higher than 3.0 (included) and revisions less than 3.0
		have huge hardware difference.
		Revisions higher than 3.0 (included) is not compatible with 0.x and 1.x.

choice ESP32P4_REV_MIN
	prompt "Minimum Supported ESP32-P4 Revision"
	default ESP32P4_REV_MIN_301
	---help---
		Required minimum chip revision. ESP-IDF will check for it and
		reject to boot if the chip revision fails the check.
		This ensures the chip used will have some modifications (features, or bugfixes).

		The compiled binary will only support chips above this revision,
		this will also help to reduce binary size.

config ESP32P4_REV_MIN_0
	depends on ESP32P4_SELECTS_REV_LESS_V3
	bool "Rev v0.0"

config ESP32P4_REV_MIN_1
	depends on ESP32P4_SELECTS_REV_LESS_V3
	bool "Rev v0.1"

config ESP32P4_REV_MIN_100
	depends on ESP32P4_SELECTS_REV_LESS_V3
	bool "Rev v1.0"

config ESP32P4_REV_MIN_300
	bool "Rev v3.0"
	depends on !ESP32P4_SELECTS_REV_LESS_V3

config ESP32P4_REV_MIN_301
	bool "Rev v3.1"
	depends on !ESP32P4_SELECTS_REV_LESS_V3

endchoice # ESP32P4_REV_MIN

config ESP32P4_REV_MIN_FULL
	int
	default 0 if ESP32P4_REV_MIN_0
	default 1 if ESP32P4_REV_MIN_1
	default 100 if ESP32P4_REV_MIN_100
	default 300 if ESP32P4_REV_MIN_300
	default 301 if ESP32P4_REV_MIN_301

config ESP_REV_MIN_FULL
	int
	default ESP32P4_REV_MIN_FULL

config ESP32P4_REV_MAX_FULL
	int
	default 399 if !ESP32P4_SELECTS_REV_LESS_V3
	default 199 if ESP32P4_SELECTS_REV_LESS_V3

# keep in sync the "Maximum Supported Revision" description with this value

config ESP_REV_MAX_FULL
	int
	default ESP32P4_REV_MAX_FULL

config ESP_EFUSE_BLOCK_REV_MIN_FULL
	int "Minimum Supported ESP32-P4 eFuse Block Revision"
	default 0
	---help---
		Required minimum eFuse Block revision. ESP-IDF will check it at the 2nd bootloader stage
		whether the current image can work correctly for this eFuse Block revision.
		So that to avoid running an incompatible image on a SoC that contains breaking change in the eFuse Block.
		If you want to update this value to run the image that not compatible with the current eFuse Block revision,
		please contact to Espressif's business team for details:
		https://www.espressif.com.cn/en/contact-us/sales-questions

config ESP_EFUSE_BLOCK_REV_MAX_FULL
	int
	default 199
	comment "Maximum Supported ESP32-P4 eFuse Block Revision (eFuse Block Rev v0.99)"

# The revision in the comment must correspond to the default value of ESP_EFUSE_BLOCK_REV_MAX_FULL

menu "Cache config"

choice ESPRESSIF_CACHE_L2_CACHE_SIZE_SELECT
	prompt "L2 cache size"
	default ESPRESSIF_CACHE_L2_CACHE_256KB
	---help---
		L2 cache size to be set on application startup.

config ESPRESSIF_CACHE_L2_CACHE_128KB
	bool "128KB"

config ESPRESSIF_CACHE_L2_CACHE_256KB
	bool "256KB"

config ESPRESSIF_CACHE_L2_CACHE_512KB
	bool "512KB"

endchoice # ESPRESSIF_CACHE_L2_CACHE_SIZE_SELECT

config ESPRESSIF_CACHE_L2_CACHE_SIZE
	hex
	default 0x20000 if ESPRESSIF_CACHE_L2_CACHE_128KB
	default 0x40000 if ESPRESSIF_CACHE_L2_CACHE_256KB
	default 0x80000 if ESPRESSIF_CACHE_L2_CACHE_512KB

choice ESPRESSIF_CACHE_L2_CACHE_LINE_SIZE_SELECT
	prompt "L2 cache line size"
	default ESPRESSIF_CACHE_L2_CACHE_LINE_64B if ESPRESSIF_CACHE_L2_CACHE_128KB
	default ESPRESSIF_CACHE_L2_CACHE_LINE_64B if ESPRESSIF_CACHE_L2_CACHE_256KB
	default ESPRESSIF_CACHE_L2_CACHE_LINE_128B if ESPRESSIF_CACHE_L2_CACHE_512KB
	---help---
		L2 cache line size to be set on application startup.

config ESPRESSIF_CACHE_L2_CACHE_LINE_64B
	bool "64 Bytes"
	depends on ESPRESSIF_CACHE_L2_CACHE_128KB || ESPRESSIF_CACHE_L2_CACHE_256KB

config ESPRESSIF_CACHE_L2_CACHE_LINE_128B
	bool "128 Bytes"

endchoice # ESPRESSIF_CACHE_L2_CACHE_LINE_SIZE_SELECT

config ESPRESSIF_CACHE_L2_CACHE_LINE_SIZE
	int
	default 64 if ESPRESSIF_CACHE_L2_CACHE_LINE_64B
	default 128 if ESPRESSIF_CACHE_L2_CACHE_LINE_128B

config ESPRESSIF_CACHE_L1_CACHE_LINE_SIZE
	int
	default 64

endmenu # Cache config

choice ESPRESSIF_CPU_FREQ
	prompt "CPU frequency"
	default ESPRESSIF_CPU_FREQ_40 if ARCH_CHIP_ESP32P4 && ESPRESSIF_IDF_ENV_FPGA
	default ESPRESSIF_CPU_FREQ_96 if ARCH_CHIP_ESP32H2
	default ESPRESSIF_CPU_FREQ_160 if ARCH_CHIP_ESP32C3 || ARCH_CHIP_ESP32C6
	default ESPRESSIF_CPU_FREQ_360 if ARCH_CHIP_ESP32P4 && ESP32P4_SELECTS_REV_LESS_V3
	default ESPRESSIF_CPU_FREQ_400 if ARCH_CHIP_ESP32P4 && !ESP32P4_SELECTS_REV_LESS_V3
	---help---
		CPU frequency to be set on application startup.

config ESPRESSIF_CPU_FREQ_40
	bool "40 MHz"
	depends on ARCH_CHIP_ESP32C3 || ARCH_CHIP_ESP32C6 || ARCH_CHIP_ESP32P4
	---help---
		Set the CPU frequency to 40 MHz.

config ESPRESSIF_CPU_FREQ_48
	bool "48 MHz"
	depends on ARCH_CHIP_ESP32H2
	---help---
		Set the CPU frequency to 48 MHz.

config ESPRESSIF_CPU_FREQ_64
	bool "64 MHz"
	depends on ARCH_CHIP_ESP32H2
	---help---
		Set the CPU frequency to 64 MHz.

config ESPRESSIF_CPU_FREQ_80
	bool "80 MHz"
	depends on ARCH_CHIP_ESP32C3 || ARCH_CHIP_ESP32C6
	---help---
		Set the CPU frequency to 80 MHz.

config ESPRESSIF_CPU_FREQ_96
	bool "96 MHz"
	depends on ARCH_CHIP_ESP32H2
	---help---
		Set the CPU frequency to 96 MHz.

config ESPRESSIF_CPU_FREQ_160
	bool "160 MHz"
	depends on ARCH_CHIP_ESP32C3 || ARCH_CHIP_ESP32C6
	---help---
		Set the CPU frequency to 160 MHz.

config ESPRESSIF_CPU_FREQ_360
	bool "360 MHz"
	depends on ARCH_CHIP_ESP32P4 && ESP32P4_SELECTS_REV_LESS_V3
	---help---
		Set the CPU frequency to 360 MHz.

config ESPRESSIF_CPU_FREQ_400
	bool "400 MHz"
	depends on ARCH_CHIP_ESP32P4 && !ESP32P4_SELECTS_REV_LESS_V3
	---help---
		Set the CPU frequency to 400 MHz.

endchoice # ESPRESSIF_CPU_FREQ

config ESPRESSIF_CPU_FREQ_MHZ
	int
	default 40 if ESPRESSIF_CPU_FREQ_40
	default 48 if ESPRESSIF_CPU_FREQ_48
	default 64 if ESPRESSIF_CPU_FREQ_64
	default 80 if ESPRESSIF_CPU_FREQ_80
	default 96 if ESPRESSIF_CPU_FREQ_96
	default 160 if ESPRESSIF_CPU_FREQ_160
	default 360 if ESPRESSIF_CPU_FREQ_360
	default 400 if ESPRESSIF_CPU_FREQ_400


menu "Espressif Log Level"
	visible if DEBUG_FEATURES

config ESPRESSIF_LOG_LEVEL_NONE
	bool "NONE"
	depends on !DEBUG_FEATURES && !DEBUG_ERROR && !DEBUG_WARN && !DEBUG_INFO
	default y
	---help---
		No log output from Espressif log messages.

config ESPRESSIF_LOG_LEVEL_ERROR
	bool "ERROR"
	depends on DEBUG_ERROR
	default y
	---help---
		Display critical errors from Espressif log messages.

config ESPRESSIF_LOG_LEVEL_WARN
	bool "WARN"
	depends on DEBUG_WARN
	default y
	---help---
		Display warning messages from Espressif log messages.

config ESPRESSIF_LOG_LEVEL_INFO
	bool "INFO"
	depends on DEBUG_INFO
	default y
	---help---
		Display information messages from Espressif log messages.

config ESPRESSIF_LOG_LEVEL_DEBUG
	bool "DEBUG"
	depends on DEBUG_INFO
	default n
	---help---
		Display extra information from Espressif log messages.

config ESPRESSIF_LOG_LEVEL_VERBOSE
	bool "VERBOSE"
	depends on DEBUG_INFO
	default n
	---help---
		Display bigger chunks of debugging information, or frequent messages
		which can potentially flood the output from Espressif log messages.

config ESPRESSIF_LOG_LEVEL
	int
	default 5 if ESPRESSIF_LOG_LEVEL_VERBOSE
	default 4 if ESPRESSIF_LOG_LEVEL_DEBUG
	default 3 if ESPRESSIF_LOG_LEVEL_INFO
	default 2 if ESPRESSIF_LOG_LEVEL_WARN
	default 1 if ESPRESSIF_LOG_LEVEL_ERROR
	default 0 if ESPRESSIF_LOG_LEVEL_NONE

endmenu # Espressif Log Level

config ESPRESSIF_DONT_USE_ROM_LIBC
	bool "Don't use ROM libc functions"
	default n
	---help---
		If enabled, NuttX libc will be used instead of ROM newlib
		functions (strdup, strndup, atoi, etc.).

		This prevents cross-heap allocation issues when ROM newlib
		allocators are not mapped to the same heap as NuttX libc.

menuconfig ESPRESSIF_SPIRAM
	bool "External SPI RAM (SPIRAM)"
	default n
	---help---
		Enable external PSRAM support through the ESP HAL component.

if ESPRESSIF_SPIRAM

config ESPRESSIF_SPIRAM_BOOT_INIT
	bool "Initialize SPIRAM during early boot"
	default y
	---help---
		Initialize and map external PSRAM before heap region registration.

config ESPRESSIF_SPIRAM_IGNORE_NOTFOUND
	bool "Ignore SPIRAM not found"
	depends on !ESPRESSIF_SPIRAM_ALLOW_BSS_SEG_EXTERNAL_MEMORY
	default n
	---help---
		Keep booting even if PSRAM detection fails.

config ESPRESSIF_SPIRAM_MEMTEST
	bool "Run SPIRAM memory test at boot"
	default y
	---help---
		Run a basic memory test before adding PSRAM to the allocator.

config ESPRESSIF_SPIRAM_USE_8LINE_MODE
	bool "Use x8 line mode"
	default n
	---help---
		Enable x8 line mode instead of x16 line mode.

config ESPRESSIF_SPIRAM_ECC
	bool "Enable SPIRAM ECC"
	default n
	---help---
		Enable ECC for external PSRAM accesses.

choice ESPRESSIF_SPIRAM_SPEED
	prompt "SPIRAM speed"
	default ESPRESSIF_SPIRAM_SPEED_200M if !ESP32P4_REV_MIN_0
	default ESPRESSIF_SPIRAM_SPEED_80M

config ESPRESSIF_SPIRAM_SPEED_20M
	bool "20 MHz"

config ESPRESSIF_SPIRAM_SPEED_80M
	bool "80 MHz"

config ESPRESSIF_SPIRAM_SPEED_200M
	bool "200 MHz"
	depends on !ESP32P4_REV_MIN_0

config ESPRESSIF_SPIRAM_SPEED_250M
	bool "250 MHz"
	depends on !ESP32P4_REV_MIN_0

endchoice # ESPRESSIF_SPIRAM_SPEED

config ESPRESSIF_SPIRAM_SPEED
	int
	default 20 if ESPRESSIF_SPIRAM_SPEED_20M
	default 80 if ESPRESSIF_SPIRAM_SPEED_80M
	default 200 if ESPRESSIF_SPIRAM_SPEED_200M
	default 250 if ESPRESSIF_SPIRAM_SPEED_250M

config ESPRESSIF_SPIRAM_USER_HEAP
	bool "Add SPIRAM to user heap"
	default y
	select ESPRESSIF_DONT_USE_ROM_LIBC
	---help---
		Add SPIRAM as an additional NuttX heap region.

config ESPRESSIF_SPIRAM_ALLOW_BSS_SEG_EXTERNAL_MEMORY
	bool "Allow .bss segment placed in external memory"
	default n
	---help---
		If enabled, variables with EXT_RAM_BSS_ATTR attribute will be
		placed in SPIRAM instead of internal DRAM.

		BSS sections from esp-hal-3rdparty components can also be placed
		in SPIRAM through linker fragment mappings when enabled.

		Note that variables placed in SPIRAM this way are still
		zero-initialized at startup.

endif # ESPRESSIF_SPIRAM

# Aggregate I2C controller mode gates consumed by the driver layer
# (espressif/Make.defs and the board glue).  The P4 port currently
# supports master mode only; the controllers themselves (ESPRESSIF_I2C0/1)
# are defined in the sourced common Kconfig.

config ESPRESSIF_I2C0_MASTER_MODE
	bool
	default y if ESPRESSIF_I2C0

config ESPRESSIF_I2C1_MASTER_MODE
	bool
	default y if ESPRESSIF_I2C1

config ESPRESSIF_I2C_PERIPH_MASTER_MODE
	bool
	default y if ESPRESSIF_I2C0_MASTER_MODE || ESPRESSIF_I2C1_MASTER_MODE

config ESPRESSIF_I2C_PERIPH_SLAVE_MODE
	bool
	default n

config ESPRESSIF_MIPI_DSI
	bool "MIPI DSI display support"
	default n
	select FB_UPDATE if VIDEO_FB
	---help---
		Enable the MIPI DSI host/bridge driver used to drive DSI panels
		in DPI video mode, continuously streaming an RGB565 framebuffer
		through a dedicated DW-GDMA channel.

config ESPRESSIF_MIPI_CSI
	bool "MIPI CSI camera support"
	default n
	---help---
		Enable the native MIPI CSI host/bridge driver used to receive
		camera sensor frames over the CSI-2 interface. Frames are
		delivered through a dedicated DW-GDMA channel into PSRAM
		double buffers (see esp32p4_mipi_csi.c).

endif # ARCH_CHIP_ESP32P4

config P4_REV3_MSPI_CRASH_AFTER_POWER_UP_WORKAROUND
	bool
	default y if ESP32P4_REV_MIN_300

config P4_REV3_MSPI_WORKAROUND_SIZE
	hex
	default 0x100 if ESP32P4_REV_MIN_300
	default 0
```

## arch/tricore/Kconfig
```kconfig
#
# For a description of the syntax of this configuration file,
# see the file kconfig-language.txt in the NuttX tools repository.
#

if ARCH_TRICORE
comment "Tricore Options"

choice
	prompt "Tricore Toolchain Selection"
	default TRICORE_TOOLCHAIN_GNU

config TRICORE_TOOLCHAIN_TASKING
	bool "AURIX Tasking C/C++ toolchain"
	select ARCH_TOOLCHAIN_TASKING

config TRICORE_TOOLCHAIN_GNU
	bool "Generic GNU toolchain"
	select ARCH_TOOLCHAIN_GNU
	---help---
		This option should work for any modern GNU toolchain (GCC 4.5 or newer)

endchoice # Tricore Toolchain Selection

config ARCH_TC1V6
	bool
	select ARCH_HAVE_MPU
	select ARCH_HAVE_IRQTRIGGER
	select ARCH_HAVE_PERF_EVENTS
	select ARCH_HAVE_POWEROFF
	select ARCH_HAVE_PERF_EVENTS_USER_ACCESS
	select ARCH_HAVE_SETJMP
	select ARCH_HAVE_RESET
	default n

config ARCH_TC1V8
	bool
	select ARCH_DCACHE
	select ARCH_ICACHE
	select ARCH_HAVE_MPU
	select ARCH_HAVE_IRQTRIGGER
	select ARCH_HAVE_PERF_EVENTS
	select ARCH_HAVE_PERF_EVENTS_USER_ACCESS
	select ARCH_HAVE_POWEROFF
	select ARCH_HAVE_PPRS
	select ARCH_HAVE_SETJMP
	select ARCH_HAVE_RESET
	default n

config ARCH_FAMILY
	string
	default "tc1v6"		if ARCH_TC1V6
	default "tc1v8"		if ARCH_TC1V8

config ARCH_CHIP_TC3XX
	bool "infineon aurix tc3xx"
	select ARCH_TC1V6
	select ARCH_HAVE_ADDRENV
	select ARCH_HAVE_MULTICPU
	select ARCH_HAVE_I2CRESET
	select ARCH_MINIMAL_VECTORTABLE
	select ARCH_MINIMAL_VECTORTABLE_DYNAMIC
	select ALARM_ARCH
	select ONESHOT
	select ONESHOT_COUNT
	---help---
		Infineon aurix tc3xx (six cores)

config ARCH_CHIP_TC4XX
	bool "infineon aurix tc4xx"
	select ARCH_TC1V8
	select ARCH_HAVE_ADDRENV
	select ARCH_HAVE_MULTICPU
	select ARCH_HAVE_I2CRESET
	select ARCH_MINIMAL_VECTORTABLE
	select ARCH_MINIMAL_VECTORTABLE_DYNAMIC
	select ALARM_ARCH
	select ONESHOT
	select ONESHOT_COUNT
	select HAVE_SECURITY_CORE
	---help---
		Infineon aurix tc4xx (six cores and one security core)

config ARCH_CHIP
	string
	default "tc3xx"		if ARCH_CHIP_TC3XX
	default "tc4xx"		if ARCH_CHIP_TC4XX

config ARCH_DCACHE_ADDR
	hex "AURIX Dcache base address"
	default 0x7003C000
	---help---
		AURIX Dcache base address, dcache line clear and invalidate need
		use thie address.

config ARCH_MPU_NSETS
	int "Protection sets number"
	default 7
	---help---
		The protection sets count

config ARCH_MPU_DATA_NREGIONS
	int "Data regions number"
	default 23
	---help---
		The data regions count

config ARCH_MPU_CODE_NREGIONS
	int "Code regions variables"
	default 15
	---help---
		The code regions count

config ARCH_HAVE_PPRS
	bool
	---help---
		The saving process for MPU PRS differs between TC1V6 and TC1V8.TC1V6
		saves PRS in the PSW, while TC1V8 saves PRS in the PPRS register.

config HAVE_SECURITY_CORE
	bool
	---help---
		In addition to the 6 cores, tc4xx also has one more security core.

if ARCH_CHIP_TC3XX
source "arch/tricore/src/tc3xx/Kconfig"
endif
endif # ARCH_TRICORE
```
