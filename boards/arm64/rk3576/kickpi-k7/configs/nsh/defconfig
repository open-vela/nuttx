## libs/libc/gnssutils/Kconfig
```kconfig
#
# For a description of the syntax of this configuration file,
# see the file kconfig-language.txt in the NuttX tools repository.
#

config GNSSUTILS_MINMEA_LIB
	bool "MINMEA NMEA Library"
	default n
	---help---
		Enable support for the MINMEA NMEA library.

		NOTE: This library depends on having some version of math.h
		at include/nuttx.  There are some different ways to accomplish
		this.  See the discussion in the top-level nuttx/README.txt file.

if GNSSUTILS_MINMEA_LIB

config GNSSUTILS_MINMEA_VERSION_4_10
	bool "MINMEAD NMEA version 4.10"
	default n
	---help---
		Enable support for nmea version 4.10.
		NOTE: This library depends on gps gnssutils/minmea.
		Open when get nmea data with version 4.10

endif
```
