## boards/arm/t113/t113-evb/uartring/Kconfig
```kconfig
#
# For a description of the syntax of this configuration file,
# see the file kconfig-language.txt in the NuttX tools repository.
#

config EXAMPLES_UARTRING
	tristate "UART ring test"
	default n
	depends on SERIAL_TERMIOS
	---help---
		UART ring loopback test.  Wires N UARTs in a ring
		(each TX to the next RX) and sends a known pattern
		through the chain to verify data integrity and
		measure throughput at the configured baud rate.

if EXAMPLES_UARTRING

config EXAMPLES_UARTRING_STACKSIZE
	int "Stack size"
	default 4096

config EXAMPLES_UARTRING_PRIORITY
	int "Task priority"
	default 100

config EXAMPLES_UARTRING_BAUD
	int "Default baud rate"
	default 115200

config EXAMPLES_UARTRING_SIZE
	int "Default transfer size in bytes"
	default 1048576

endif

config EXAMPLES_UARTDIAG
	tristate "UART diagnostic"
	default n
	---help---
		Minimal UART TX/RX diagnostic tool.
		No threads, no termios — raw open/write/read.

if EXAMPLES_UARTDIAG

config EXAMPLES_UARTDIAG_STACKSIZE
	int "Stack size"
	default 4096

config EXAMPLES_UARTDIAG_PRIORITY
	int "Task priority"
	default 100

endif
```

## boards/arm64/rk3588/evb7-amp/Kconfig
```kconfig
#
# For a description of the syntax of this configuration file,
# see the file kconfig-language.txt in the NuttX tools repository.
#

if ARCH_BOARD_EVB7_AMP

config EVB7_AMP_FB
	bool "Framebuffer over the AMP shared area"
	default n
	depends on RPTUN
	select DRIVERS_VIDEO
	select VIDEO_FB
	select FB_UPDATE
	---help---
		Register /dev/fb0 on top of the shared frame area, so applications on
		this core draw with ordinary framebuffer calls and Linux puts the
		result on the panel.

		There is no display controller behind this: the VOP's IOMMU and
		interrupt are shared across all of its video ports, so it cannot be
		split between cores. Flushing the framebuffer therefore means
		"published to Linux", not "on the screen".

		FB_UPDATE is selected because it has no prompt of its own, and without
		it an application that signals completion with FBIO_UPDATE - which is
		what the NX and LVGL paths do - would draw into memory that is never
		announced.

config EVB7_AMP_TOUCH
	bool "Touchscreen forwarded from Linux"
	default n
	depends on RPTUN
	select INPUT
	select INPUT_TOUCHSCREEN
	---help---
		Register /dev/input0 fed by touch events that Linux decodes and forwards
		over the shared-frame rpmsg endpoint.

		The panel's touch controller is on i2c5 with its interrupt on a GPIO
		bank 3 pin. That bank has a single interrupt line shared by all of its
		pins, and the Type-C power delivery controller's interrupt is on the
		same bank, so taking the touch interrupt for this core would break
		charging. Consuming events Linux has already decoded avoids the
		contention entirely and needs no i2c master on this side.

		Touch therefore depends on Linux running. Nothing here can distinguish
		"nobody is touching the screen" from "the other core stopped talking".

endif # ARCH_BOARD_EVB7_AMP
```

## boards/risc-v/esp32p4/esp32p4-function-ev-board/configs/l2_2/defconfig
```kconfig
# ESP32-P4 Function-EV cumulative L2.2 configuration.
#
# This is the next cumulative baseline after the verified L0-L2 work.  It
# includes the verified L0/L1/L2 platform support, BOOT button input, and the
# ESP32-P4 MWDT0 watchdog profile in one explicit configuration.
#
# Do not use this file as a temporary feature-only configuration.  Subsequent
# verified capabilities should be added to this cumulative baseline.

CONFIG_ARCH="risc-v"
CONFIG_ARCH_FAMILY="risc-v"
CONFIG_ARCH_BOARD="esp32p4-function-ev-board"
CONFIG_ARCH_BOARD_COMMON=y
CONFIG_ARCH_BOARD_ESP32P4_FUNCTION_EV_BOARD=y
CONFIG_ARCH_CHIP="esp32p4"
CONFIG_ARCH_CHIP_ESP32P4=y
CONFIG_ARCH_INTERRUPTSTACK=2048
CONFIG_ARCH_IRQ_TO_NDX=y
CONFIG_ARCH_MINIMAL_VECTORTABLE_DYNAMIC=y
CONFIG_ARCH_NUSER_INTERRUPTS=17
CONFIG_ARCH_RISCV=y
CONFIG_ARCH_RV32=y
CONFIG_ARCH_RV_ISA_M=y
CONFIG_ARCH_RV_ISA_A=y
CONFIG_ARCH_RV_ISA_C=y
CONFIG_ARCH_RV_ISA_ZICSR_ZIFENCEI=y
CONFIG_ARCH_STACKDUMP=y
CONFIG_ARCH_TOOLCHAIN_GNU=y
CONFIG_ARCH_BUTTONS=y
CONFIG_ARCH_IRQBUTTONS=y
CONFIG_BOARD_LATE_INITIALIZE=y
CONFIG_BOARD_INITTHREAD_PRIORITY=240
CONFIG_BOARD_INITTHREAD_STACKSIZE=2048
CONFIG_BOARD_LOOPSPERMSEC=15000
CONFIG_BUILTIN=y
CONFIG_DEV_GPIO=y
CONFIG_ESPRESSIF_GPIO_IRQ=y
CONFIG_ESPRESSIF_CHIP_SERIES="esp32p4"
CONFIG_ESPRESSIF_ESP32P4=y
CONFIG_ESPRESSIF_FLASH_16M=y
CONFIG_ESPRESSIF_FLASH_MODE_QIO=y
CONFIG_ESPRESSIF_FLASH_FREQ_80M=y
CONFIG_ESPRESSIF_CPU_FREQ_400=y
CONFIG_ESPRESSIF_CPU_FREQ_MHZ=400
CONFIG_ESPRESSIF_LOG_LEVEL=3
CONFIG_ESPRESSIF_NUM_CPUS=2
CONFIG_ESPRESSIF_SIMPLE_BOOT=y
CONFIG_ESPRESSIF_LEDC=y
CONFIG_ESPRESSIF_LEDC_CHANNEL0_PIN=26
CONFIG_ESPRESSIF_LEDC_TIMER0=y
CONFIG_ESPRESSIF_MWDT0=y
CONFIG_ESPRESSIF_SPIRAM=y
CONFIG_ESPRESSIF_SPIRAM_USER_HEAP=y
CONFIG_EXAMPLES_BUTTONS=y
CONFIG_EXAMPLES_BUTTONS_NAMES=y
CONFIG_EXAMPLES_BUTTONS_NAME0="BOOT"
CONFIG_EXAMPLES_BUTTONS_POLL=y
CONFIG_EXAMPLES_BUTTONS_PRIORITY=110
CONFIG_EXAMPLES_BUTTONS_STACKSIZE=4096
CONFIG_EXAMPLES_GPIO=y
CONFIG_EXAMPLES_PWM=y
CONFIG_EXAMPLES_WATCHDOG=y
CONFIG_EXPERIMENTAL=y
CONFIG_FS_PROCFS=y
CONFIG_IDLETHREAD_STACKSIZE=2048
CONFIG_INIT_ENTRYPOINT="nsh_main"
CONFIG_INTELHEX_BINARY=y
CONFIG_INPUT=y
CONFIG_INPUT_BUTTONS=y
CONFIG_INPUT_BUTTONS_LOWER=y
CONFIG_LIBC_FLOATINGPOINT=y
CONFIG_LIBC_PERROR_STDOUT=y
CONFIG_LIBC_STRERROR=y
CONFIG_MM_REGIONS=2
CONFIG_NFILE_DESCRIPTORS_PER_BLOCK=6
CONFIG_NSH_BUILTIN_APPS=y
CONFIG_NSH_FILEIOSIZE=512
CONFIG_NSH_READLINE=y
CONFIG_NSH_STRERROR=y
CONFIG_PID_INITIAL_COUNT=8
CONFIG_PREALLOC_MQ_IRQ_MSGS=4
CONFIG_PREALLOC_MQ_MSGS=4
CONFIG_PREALLOC_TIMERS=4
CONFIG_RAW_BINARY=y
CONFIG_RISCV_TOOLCHAIN_GNU_RV32=y
CONFIG_RR_INTERVAL=200
CONFIG_SCHED_BACKTRACE=y
CONFIG_SCHED_CHILD_STATUS=y
CONFIG_SCHED_HAVE_PARENT=y
CONFIG_SCHED_TICKLESS=y
CONFIG_SCHED_WAITPID=y
CONFIG_SIG_PREALLOC_IRQ_ACTIONS=4
CONFIG_SMP_NCPUS=2
CONFIG_START_DAY=29
CONFIG_START_MONTH=11
CONFIG_START_YEAR=2019
CONFIG_SYSTEM_DUMPSTACK=y
CONFIG_SYSTEM_NSH=y
CONFIG_TESTING_RAMTEST=y
CONFIG_UART0_SERIAL_CONSOLE=y
CONFIG_USEC_PER_TICK=1000

# Keep the buttons example in polling mode; signal mode was not part of the
# verified BOOT press/release result.
# CONFIG_EXAMPLES_BUTTONS_SIGNAL is not set
```

## boards/risc-v/esp32p4/esp32p4-function-ev-board/configs/l2_6_spiflash/defconfig
```kconfig
# ESP32-P4 Function-EV cumulative L2.5 configuration plus board-mounted SPI
# Flash MTD and SmartFS.
#
# This configuration carries forward the verified L2.5 baseline and adds the
# board-mounted SPI Flash storage path. The storage range follows the existing
# same-board reference configuration and is kept below the 16 MiB flash end.

CONFIG_ARCH="risc-v"
CONFIG_ARCH_FAMILY="risc-v"
CONFIG_ARCH_BOARD="esp32p4-function-ev-board"
CONFIG_ARCH_BOARD_COMMON=y
CONFIG_ARCH_BOARD_ESP32P4_FUNCTION_EV_BOARD=y
CONFIG_ARCH_CHIP="esp32p4"
CONFIG_ARCH_CHIP_ESP32P4=y
CONFIG_ARCH_INTERRUPTSTACK=2048
CONFIG_ARCH_IRQ_TO_NDX=y
CONFIG_ARCH_MINIMAL_VECTORTABLE_DYNAMIC=y
CONFIG_ARCH_NUSER_INTERRUPTS=17
CONFIG_ARCH_RISCV=y
CONFIG_ARCH_RV32=y
CONFIG_ARCH_RV_ISA_M=y
CONFIG_ARCH_RV_ISA_A=y
CONFIG_ARCH_RV_ISA_C=y
CONFIG_ARCH_RV_ISA_ZICSR_ZIFENCEI=y
CONFIG_ARCH_STACKDUMP=y
CONFIG_ARCH_TOOLCHAIN_GNU=y
CONFIG_ARCH_BUTTONS=y
CONFIG_ARCH_IRQBUTTONS=y
CONFIG_BOARD_LATE_INITIALIZE=y
CONFIG_BOARD_INITTHREAD_PRIORITY=240
CONFIG_BOARD_INITTHREAD_STACKSIZE=2048
CONFIG_BOARD_LOOPSPERMSEC=15000
CONFIG_BUILTIN=y
CONFIG_DEV_GPIO=y
CONFIG_ESPRESSIF_GPIO_IRQ=y
CONFIG_ESPRESSIF_CHIP_SERIES="esp32p4"
CONFIG_ESPRESSIF_ESP32P4=y
CONFIG_ESPRESSIF_FLASH_16M=y
CONFIG_ESPRESSIF_FLASH_MODE_QIO=y
CONFIG_ESPRESSIF_FLASH_FREQ_80M=y
CONFIG_ESPRESSIF_CPU_FREQ_400=y
CONFIG_ESPRESSIF_CPU_FREQ_MHZ=400
CONFIG_ESPRESSIF_LOG_LEVEL=3
CONFIG_ESPRESSIF_NUM_CPUS=2
CONFIG_ESPRESSIF_SIMPLE_BOOT=y
CONFIG_ESPRESSIF_LEDC=y
CONFIG_ESPRESSIF_LEDC_CHANNEL0_PIN=26
CONFIG_ESPRESSIF_LEDC_TIMER0=y
CONFIG_ESPRESSIF_MIPI_DSI=y
CONFIG_ESPRESSIF_MIPI_CSI=y
CONFIG_ESPRESSIF_MIPI_DSI_BUS=0
CONFIG_ESPRESSIF_MIPI_DSI_LANES=2
CONFIG_ESPRESSIF_MIPI_DSI_LANE_BITRATE_MBPS=500
CONFIG_VIDEO_FB=y
CONFIG_VIDEO_STREAM=y
CONFIG_VIDEO_REQBUFS_COUNT_MAX=3
CONFIG_SCHED_HPWORK=y
CONFIG_FB_UPDATE=y
CONFIG_GRAPHICS_LVGL=y
CONFIG_LV_CONF_SKIP=y
CONFIG_LV_COLOR_DEPTH_16=y
CONFIG_LV_FONT_UNSCII_16=y
CONFIG_LV_USE_FONT_COMPRESSED=y
CONFIG_LV_USE_FS_POSIX=y
CONFIG_LV_FS_POSIX_LETTER=83
CONFIG_LV_FS_POSIX_PATH=""
CONFIG_LV_USE_CLIB_MALLOC=y
CONFIG_LV_USE_CLIB_STRING=y
CONFIG_LV_USE_CLIB_SPRINTF=y
CONFIG_LV_USE_KEYBOARD=y
CONFIG_LV_USE_NUTTX=y
CONFIG_LV_USE_NUTTX_TOUCHSCREEN=y
CONFIG_LV_USE_TEXTAREA=y
CONFIG_LV_USE_DEMO_WIDGETS=y
CONFIG_EXAMPLES_LVGLDEMO=y
CONFIG_EXAMPLES_TOUCHSCREEN=y
CONFIG_ESPRESSIF_MWDT0=y
CONFIG_ESPRESSIF_SPIRAM=y
CONFIG_ESPRESSIF_SPIRAM_USER_HEAP=y
CONFIG_ESPRESSIF_I2C0=y
CONFIG_ESPRESSIF_I2C0_SDAPIN=7
CONFIG_ESPRESSIF_I2C0_SCLPIN=8
CONFIG_ESPRESSIF_SPI2=y
CONFIG_ESPRESSIF_SPI2_CSPIN=20
CONFIG_ESPRESSIF_SPI2_CLKPIN=21
CONFIG_ESPRESSIF_SPI2_MOSIPIN=4
CONFIG_ESPRESSIF_SPI2_MISOPIN=5
CONFIG_ESPRESSIF_SPIFLASH=y
CONFIG_ESPRESSIF_SPIFLASH_SMARTFS=y
CONFIG_ESPRESSIF_STORAGE_MTD_OFFSET=0x110000
CONFIG_ESPRESSIF_STORAGE_MTD_SIZE=0xf0000
CONFIG_ESPRESSIF_SPIFLASH_FS_MOUNT_PT="/data"
CONFIG_EXAMPLES_BUTTONS=y
CONFIG_EXAMPLES_BUTTONS_NAMES=y
CONFIG_EXAMPLES_BUTTONS_NAME0="BOOT"
CONFIG_EXAMPLES_BUTTONS_POLL=y
CONFIG_EXAMPLES_BUTTONS_PRIORITY=110
CONFIG_EXAMPLES_BUTTONS_STACKSIZE=4096
CONFIG_EXAMPLES_GPIO=y
CONFIG_EXAMPLES_PWM=y
CONFIG_EXAMPLES_WATCHDOG=y
CONFIG_EXPERIMENTAL=y
CONFIG_FS_PROCFS=y
CONFIG_IDLETHREAD_STACKSIZE=2048
CONFIG_INIT_ENTRYPOINT="nsh_main"
CONFIG_INTELHEX_BINARY=y
CONFIG_INPUT=y
CONFIG_INPUT_GT9XX=y
CONFIG_INPUT_BUTTONS=y
CONFIG_INPUT_BUTTONS_LOWER=y
CONFIG_LIBC_EXECFUNCS=y
CONFIG_LIBC_FLOATINGPOINT=y
CONFIG_LIBC_PERROR_STDOUT=y
CONFIG_LIBC_STRERROR=y
CONFIG_MM_REGIONS=2
CONFIG_NFILE_DESCRIPTORS_PER_BLOCK=6
CONFIG_NSH_BUILTIN_APPS=y
CONFIG_NSH_FILEIOSIZE=512
CONFIG_NSH_READLINE=y
CONFIG_NSH_STRERROR=y
CONFIG_NSH_MAXARGUMENTS=16
CONFIG_PID_INITIAL_COUNT=8
CONFIG_PREALLOC_MQ_IRQ_MSGS=4
CONFIG_PREALLOC_MQ_MSGS=4
CONFIG_PREALLOC_TIMERS=4
CONFIG_PIPES=y
CONFIG_RAW_BINARY=y
CONFIG_RISCV_TOOLCHAIN_GNU_RV32=y
CONFIG_RR_INTERVAL=200
CONFIG_SCHED_BACKTRACE=y
CONFIG_SCHED_CHILD_STATUS=y
CONFIG_SCHED_HAVE_PARENT=y
CONFIG_SCHED_TICKLESS=y
CONFIG_SCHED_WAITPID=y
CONFIG_SIG_PREALLOC_IRQ_ACTIONS=4
CONFIG_SMP_NCPUS=2
CONFIG_START_DAY=29
CONFIG_START_MONTH=11
CONFIG_START_YEAR=2019
CONFIG_SYSTEM_DUMPSTACK=y
CONFIG_SYSTEM_I2CTOOL=y
CONFIG_SYSTEM_SPITOOL=y
CONFIG_SPITOOL_STACKSIZE=4096
CONFIG_I2CTOOL_MAXBUS=0
CONFIG_I2CTOOL_DEFFREQ=100000
CONFIG_SPITOOL_MINBUS=2
CONFIG_SPITOOL_MAXBUS=2
CONFIG_SPITOOL_DEFFREQ=1000000
CONFIG_SYSTEM_NSH=y
CONFIG_TESTING_RAMTEST=y
CONFIG_UART0_SERIAL_CONSOLE=y
CONFIG_SIG_DEFAULT=y
CONFIG_SIG_SIGKILL_ACTION=y
CONFIG_TTY_SIGINT=y
CONFIG_TTY_SIGINT_CHAR=0x03
CONFIG_USEC_PER_TICK=1000

# Keep the buttons example in polling mode; signal mode was not part of the
# verified BOOT press/release result.
# CONFIG_EXAMPLES_BUTTONS_SIGNAL is not set

# ESP32-P4 internal RTC counter and upper-half device.
CONFIG_RTC=y
CONFIG_RTC_DRIVER=y
CONFIG_BOARDCTL_RESET=y
```
