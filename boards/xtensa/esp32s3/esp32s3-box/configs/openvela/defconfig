## boards/xtensa/esp32s3/esp32s3-eye/Kconfig
```kconfig
#
# For a description of the syntax of this configuration file,
# see the file kconfig-language.txt in the NuttX tools repository.
#

if ARCH_BOARD_ESP32S3_EYE

config ESP32S3_EYE_LCD
	bool "Enable ESP32-S3 LCD"
	default n
	select ESP32S3_SPI2
	select SPI_CMDDATA
	select LCD
	select LCD_DEV
	select LCD_ST7789
	---help---
		Enable board LCD support, IC is LCD_ST7789V.

config ESP32S3_EYE_TOUCHSCREEN
	bool "Enable ESP32-S3 touchscreen"
	default n
	select ESP32S3_I2C0
	select INPUT
	select INPUT_FT5X06
	---help---
		Enable the board FT5X06 touchscreen on I2C0.

config ESP32S3_EYE_QMI8658
	bool "Enable ESP32-S3 QMI8658 IMU"
	default n
	select ESP32S3_I2C0
	select SENSORS
	select SENSORS_QMI8658
	---help---
		Enable the board QMI8658 accelerometer and gyroscope on I2C0.

config ESP32S3_EYE_AUDIO
	bool "Enable ESP32-S3 audio"
	default n
	select DRIVERS_AUDIO
	select AUDIO
	select AUDIO_I2S
	select AUDIO_ES8311
	select AUDIO_ES7210
	select AUDIO_DRIVER_SPECIFIC_BUFFERS
	select ESP32S3_I2C0
	select ESP32S3_I2S
	select ESP32S3_I2S0
	---help---
		Enable board audio playback and capture support using ES8311 and ES7210.

endif # ARCH_BOARD_ESP32S3_EYE
```

## boards/xtensa/t113/t113-evb-dsp/Kconfig
```kconfig
if ARCH_BOARD_T113_EVB_DSP

config BOARD_LATE_INITIALIZE
	bool
	default y

config T113_INTC_PROBE
	bool "Probe DSP_INTC source IDs at boot"
	default n
	---help---
		Run a boot-time silicon probe that enables all DSP_INTC sources
		simultaneously, attaches a recording handler to each, and waits
		for the first source to fire.  The captured source ID is logged
		via syslog and the probe disables all sources before NSH starts.

		Used to discover the per-peripheral source ID assignment for
		the T113-S3 DSP_INTC, since the datasheet does not publish it.
		Trigger by sending a byte to UART2 within the timeout window.

		Leave disabled in normal builds.

if T113_INTC_PROBE

config T113_INTC_PROBE_TIMEOUT
	int "Probe wait window (seconds)"
	default 30
	range 1 120
	---help---
		How long the probe waits for a source to fire before giving up.

endif # T113_INTC_PROBE

endif # ARCH_BOARD_T113_EVB_DSP
```

## libs/libc/machine/xtensa/Kconfig
```kconfig
#
# For a description of the syntax of this configuration file,
# see the file kconfig-language.txt in the NuttX tools repository.
#

config XTENSA_STRING_FUNCTION
	bool "Enable optimized XTENSA specific string function"
	default n
	select XTENSA_MEMCPY
	select XTENSA_MEMMOVE
	select XTENSA_MEMSET
	select XTENSA_STRCMP
	select XTENSA_STRCPY
	select XTENSA_STRLEN
	select XTENSA_STRNCPY

config XTENSA_MEMCPY
	bool "Enable optimized memcpy() for XTENSA"
	select LIBC_ARCH_MEMCPY
	---help---
		Enable optimized XTENSA specific memcpy() library function

config XTENSA_MEMMOVE
	bool "Enable optimized memmove() for XTENSA"
	select LIBC_ARCH_MEMMOVE
	---help---
		Enable optimized XTENSA specific memmove() library function

config XTENSA_MEMSET
	bool "Enable optimized memset() for XTENSA"
	select LIBC_ARCH_MEMSET
	---help---
		Enable optimized XTENSA specific memset() library function

config XTENSA_STRCMP
	bool "Enable optimized strcmp() for XTENSA"
	select LIBC_ARCH_STRCMP
	---help---
		Enable optimized XTENSA specific strcmp() library function

config XTENSA_STRCPY
	bool "Enable optimized strcpy() for XTENSA"
	select LIBC_ARCH_STRCPY
	---help---
		Enable optimized XTENSA specific strcpy() library function

config XTENSA_STRLEN
	bool "Enable optimized strlen() for XTENSA"
	select LIBC_ARCH_STRLEN
	---help---
		Enable optimized XTENSA specific strlen() library function

config XTENSA_STRNCPY
	bool "Enable optimized strncpy() for XTENSA"
	select LIBC_ARCH_STRNCPY
	---help---
		Enable optimized XTENSA specific strncpy() library function

config XTENSA_LX7_HIFI4_FLOAT
	bool "Enable HiFi4 audio-TIE accelerated soft-float helpers"
	default n
	---help---
		Override libgcc's soft-float helpers (__mulsf3, ...) with
		hand-written HiFi4 audio-TIE implementations operating on the
		AE_DR (aed) register file via single silicon FP instructions
		(mul.s, add.s, ...).  Requires the audio engine coprocessor CP1
		to be enabled (CONFIG_XTENSA_CP_INITSET must include bit 1).
		Single-precision only; double precision stays soft-float.
```

## libs/libc/sched/Kconfig
```kconfig
config SCHED_LOCK_HISTORY
    bool "Enable per-task scheduler lock history"
    default n
    ---help---
        Records scheduler lock history per task when lockcount overflows.
        Enable SCHED_BACKTRACE to capture backtraces; otherwise history
        entries will have depth 0 and only the overflow message is printed.

if SCHED_LOCK_HISTORY

config SCHED_LOCK_HISTORY_COUNT
    int "Number of history records (0 for MAX_LOCK_COUNT)"
    default 0

config SCHED_LOCK_HISTORY_DEPTH
    int "Backtrace depth per record (0 disables backtrace capture)"
    range 0 255
    default 8

config SCHED_LOCK_HISTORY_THRESHOLD
    int "Lockcount threshold to dump history (0 for MAX_LOCK_COUNT-32)"
    default 0
    ---help---
        Scheduler lock history dump triggers when lockcount reaches this
        threshold. A value of 0 uses MAX_LOCK_COUNT-32 as the default.

endif
```

## libs/libm/libm/xtensa/Kconfig
```kconfig
#
# For a description of the syntax of this configuration file,
# see the file kconfig-language.txt in the NuttX tools repository.
#

if ARCH_XTENSA

config XTENSA_LIBM
	bool "Architecture specific FPU optimizations"
	default n
	select LIBM_ARCH_FMAF
	select LIBM_ARCH_TRUNCF
	select LIBM_ARCH_SQRTF
	select LIBM_ARCH_FLOORF
	select LIBM_ARCH_CEILF
	select LIBM_ARCH_RINTF
	select LIBM_ARCH_ROUNDF
	select LIBM_ARCH_EXPF
	select LIBM_ARCH_LOGF
	select LIBM_ARCH_SINF
	select LIBM_ARCH_COSF
	select LIBM_ARCH_POWF
	select LIBM_ARCH_ASINF
	select LIBM_ARCH_EXP2F
	select LIBM_ARCH_CBRTF
	select LIBM_ARCH_HYPOTF
	select LIBM_ARCH_ERFF
	depends on XTENSA_LX7_HIFI4_FLOAT
	depends on LIBM
	---help---
		Enable Xtensa HiFi4 audio-TIE specific single-precision floating
		point optimizations (e.g. fmaf via the madd.s fused multiply-add).
		Requires the CP1 audio coprocessor (CONFIG_XTENSA_CP_INITSET bit 1)
		and the libc HiFi4 float helper overrides
		(CONFIG_XTENSA_LX7_HIFI4_FLOAT).

endif
```
